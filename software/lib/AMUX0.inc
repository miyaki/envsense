;;*****************************************************************************
;;*****************************************************************************
;;  FILENAME:   AMUX0.inc
;;  Version: 1.4, Updated on 2006/04/24 at 14:54:57
;;  Generated by PSoC Designer ver 4.4  b1884 : 14 Jan, 2007
;;
;;  DESCRIPTION:  Assembler declarations for the MUX4 user module interface
;;                for the 22/24/25/26/27xxx PSoC family of devices.
;;-----------------------------------------------------------------------------
;;  Copyright (c) Cypress MicroSystems 2000-2003. All Rights Reserved.
;;*****************************************************************************
;;*****************************************************************************

;--------------------------------------------------
; Constants for AMUX0 API's.
;--------------------------------------------------
AMUX0_MUX_COL:               equ 0
AMUX0_MUX_MASK:              equ (03 << (0*2))

AMUX0_PORT0_0:                    equ 0h
AMUX0_PORT0_2:                    equ 1h
AMUX0_PORT0_4:                    equ 2h
AMUX0_PORT0_6:                    equ 3h

AMUX0_PORT0_1:                    equ 0h
AMUX0_PORT0_3:                    equ 1h
AMUX0_PORT0_5:                    equ 2h
AMUX0_PORT0_7:                    equ 3h

; end of file AMUX0.inc
