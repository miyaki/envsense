;;*****************************************************************************
;;*****************************************************************************
;;  FILENAME: Timer8_1.inc
;;   Version: 2.5, Updated on 2006/06/19 at 11:15:48
;;  Generated by PSoC Designer ver 4.4  b1884 : 14 Jan, 2007
;;
;;  DESCRIPTION: Assembler declarations for the Timer8 user module interface
;;               for the 22/24/27/29xxx PSoC family of devices
;;-----------------------------------------------------------------------------
;;  Copyright (c) Cypress MicroSystems 2000-2004. All Rights Reserved.
;;*****************************************************************************
;;*****************************************************************************

include "m8c.inc"


;--------------------------------------------------
; Constants for Timer8_1 API's.
;--------------------------------------------------

Timer8_1_CONTROL_REG_START_BIT:            equ 0x01    ; Control register start bit
Timer8_1_INT_REG:                          equ 0x0e1
Timer8_1_INT_MASK:                         equ 0x02


;--------------------------------------------------
; Constants for Timer8_1 user defined values
;--------------------------------------------------

Timer8_1_PERIOD:                           equ 0xff
Timer8_1_COMPARE_VALUE:                    equ 0x00


;--------------------------------------------------
; Register Address Constants for Timer8_1
;--------------------------------------------------

Timer8_1_COUNTER_REG:                  equ 0x24   ; DR0 Counter register
Timer8_1_PERIOD_REG:                   equ 0x25   ; DR1 Period register
Timer8_1_COMPARE_REG:                  equ 0x26   ; DR2 CompareValue register
Timer8_1_CONTROL_REG:                  equ 0x27   ; Control register
Timer8_1_FUNC_REG:                     equ 0x24   ; Function register
Timer8_1_INPUT_REG:                    equ 0x25   ; Input register
Timer8_1_OUTPUT_REG:                   equ 0x26   ; Output register


;--------------------------------------------------
; Timer8_1 Macro 'Functions'
;--------------------------------------------------

   macro Timer8_1_Start_M
   or    reg[Timer8_1_CONTROL_REG],  Timer8_1_CONTROL_REG_START_BIT
   endm

   macro Timer8_1_Stop_M
   and   reg[Timer8_1_CONTROL_REG], ~Timer8_1_CONTROL_REG_START_BIT
   endm

   macro Timer8_1_EnableInt_M
   M8C_EnableIntMask Timer8_1_INT_REG, Timer8_1_INT_MASK
   endm

   macro Timer8_1_DisableInt_M
   M8C_DisableIntMask Timer8_1_INT_REG, Timer8_1_INT_MASK
   endm


; end of file Timer8_1.inc
